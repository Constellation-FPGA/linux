## drivers/firesim/Kconfig
```kconfig
# SPDX-License-Identifier: GPL-2.0
menu "Firesim custom drivers"

config FIRESIM_MODULES
  bool "Custom \"device drivers\" for Firesim"
  default y
  help
    The Linux built by Firemarshal for Firesim is a very minimal one. In
    particular, the booted system in Firesim does not have the necessary tools
    to compile modules out-of-tree.
    Enable this to build all custom modules "device drivers" into the kernel.

source "pipeline-delegate/Kconfig"
```

## drivers/firesim/kernel-bypass/Kconfig
```kconfig
# SPDX-License-Identifier: GPL-2.0
menu "RAFT-V Kernel-Bypass Modules"

config FIRESIM_KERNEL_BYPASS
  bool "Allow exceptions to delegate past the kernel on RISC-V"
  default y
  depends on FIRESIM_MODULES
  help
    Enable kernel-bypass of exceptions and interrupts to userspace.
```

## drivers/firesim/pipeline-delegate/Kconfig
```kconfig
# SPDX-License-Identifier: GPL-2.0
menu "Pipelined Delegation Modules"

config FIRESIM_PIPELINE_DELEGATE
  bool "Fast & Pipelined delegation of exceptions on RISC-V"
  default y
  depends on FIRESIM_MODULES
  help
    Enable pipelined delegation of exceptions and interrupts to userspace.
```
